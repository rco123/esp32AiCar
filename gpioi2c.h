#ifndef GPI2C_H
#define GPI2C_H

#include <Arduino.h>

// I2C 핀 설정 (소프트웨어 I2C)
#define SDA_PIN 4   // I2C SDA 핀 (GPIO 4)
#define SCL_PIN 15  // I2C SCL 핀 (GPIO 15)


// 현재 위치를 저장하는 전역 변수
uint8_t current_row = 0;
uint8_t current_col = 0;

// 8x16 폰트 데이터 (ASCII 코드 32~126)
// 각 문자는 16바이트로 구성됩니다.
// 예시로 일부 문자만 포함하였습니다. 실제 사용 시 모든 문자를 포함해야 합니다.

const uint8_t font8x16[][16] ={              /* 8x16 English ASCII character font */
  {0x00,0x00,0x00,0x00,0x00,0x00,0x00,0x00,0x00,0x00,0x00,0x00,0x00,0x00,0x00,0x00}, // 0x00
  {0xF0,0x08,0x28,0x08,0x08,0x28,0x08,0xF0,0x07,0x08,0x09,0x0B,0x0B,0x09,0x08,0x07}, // 0x01
  {0xF0,0xF8,0xD8,0xF8,0xF8,0xD8,0xF8,0xF0,0x07,0x0F,0x0E,0x0C,0x0C,0x0E,0x0F,0x07}, // 0x02
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  {0x00,0x00,0x60,0x90,0x90,0x60,0x00,0x00,0x00,0x00,0x00,0x00,0x00,0x00,0x00,0x00}};// 0x7F


// I2C Start Condition
void i2c_start() {
    pinMode(SDA_PIN, OUTPUT);
    pinMode(SCL_PIN, OUTPUT);
    digitalWrite(SDA_PIN, HIGH);
    digitalWrite(SCL_PIN, HIGH);
    delayMicroseconds(10);
    digitalWrite(SDA_PIN, LOW);  // Start condition: SDA goes from HIGH to LOW
    delayMicroseconds(10);
    digitalWrite(SCL_PIN, LOW);  // SCL goes LOW
}

// I2C Stop Condition
void i2c_stop() {
    digitalWrite(SDA_PIN, LOW);
    digitalWrite(SCL_PIN, LOW);
    delayMicroseconds(10);
    digitalWrite(SCL_PIN, HIGH);
    delayMicroseconds(10);
    digitalWrite(SDA_PIN, HIGH);  // Stop condition: SDA goes from LOW to HIGH
    delayMicroseconds(10);
}

// I2C Byte Write
void i2c_write_byte(uint8_t byte) {
    for (int i = 0; i < 8; i++) {
        digitalWrite(SDA_PIN, (byte & 0x80) ? HIGH : LOW);
        byte <<= 1;
        delayMicroseconds(10);
        digitalWrite(SCL_PIN, HIGH);  // Clock HIGH
        delayMicroseconds(10);
        digitalWrite(SCL_PIN, LOW);   // Clock LOW
        delayMicroseconds(10);
    }
    // ACK (Slave acknowledgment)
    pinMode(SDA_PIN, INPUT);
    digitalWrite(SCL_PIN, HIGH);
    delayMicroseconds(10);
    digitalWrite(SCL_PIN, LOW);
    pinMode(SDA_PIN, OUTPUT);
}

// SSD1306 Command Send
void ssd1306_send_command(uint8_t command) {
    i2c_start();
    i2c_write_byte(0x3C << 1);  // SSD1306 I2C address (0x3C) with write bit
    i2c_write_byte(0x00);       // Control byte: next byte is a command
    i2c_write_byte(command);    // Send command
    i2c_stop();
}

// SSD1306 Data Send
void ssd1306_send_data(uint8_t data) {
    i2c_start();
    i2c_write_byte(0x3C << 1);  // SSD1306 I2C address with write bit
    i2c_write_byte(0x40);       // Control byte: next byte is data
    i2c_write_byte(data);       // Send data
    i2c_stop();
}

// SSD1306 Initialization
void ssd1306_init() {
    ssd1306_send_command(0xAE); // Display OFF
    ssd1306_send_command(0xD5); // Set Display Clock Divide Ratio/Oscillator Frequency
    ssd1306_send_command(0x80);
    ssd1306_send_command(0xA8); // Set Multiplex Ratio
    ssd1306_send_command(0x1F); // 0x1F for 128x32 display
    ssd1306_send_command(0xD3); // Set Display Offset
    ssd1306_send_command(0x00);
    ssd1306_send_command(0x40); // Set Display Start Line
    ssd1306_send_command(0x8D); // Charge Pump Setting
    ssd1306_send_command(0x14);
    ssd1306_send_command(0x20); // Memory Addressing Mode
    ssd1306_send_command(0x00); // Horizontal addressing mode
    ssd1306_send_command(0xA1); // Set Segment Re-map
    ssd1306_send_command(0xC8); // Set COM Output Scan Direction
    ssd1306_send_command(0xDA); // Set COM Pins hardware configuration
    ssd1306_send_command(0x02); // For 128x32 display
    ssd1306_send_command(0x81); // Set Contrast Control
    ssd1306_send_command(0x8F);
    ssd1306_send_command(0xD9); // Set Pre-charge Period
    ssd1306_send_command(0xF1);
    ssd1306_send_command(0xDB); // Set VCOMH Deselect Level
    ssd1306_send_command(0x40);
    ssd1306_send_command(0xA4); // Disable Entire Display On
    ssd1306_send_command(0xA6); // Set Normal Display
    ssd1306_send_command(0xAF); // Display ON
}

// Clear Display Function
void ssd1306_clear_display() {
    for (uint8_t page = 0; page < 4; page++) {
        ssd1306_send_command(0xB0 + page); // Set page address
        ssd1306_send_command(0x00);        // Set lower column address
        ssd1306_send_command(0x10);        // Set higher column address
        i2c_start();
        i2c_write_byte(0x3C << 1);
        i2c_write_byte(0x40); // Control byte for data
        for (uint8_t col = 0; col < 128; col++) {
            i2c_write_byte(0x00); // Clear data
        }
        i2c_stop();
    }
}

// Write a single character in 8x16 font
void ssd1306_write_char_8x16(char c, uint8_t row, uint8_t col) {
    if (c < 32 || c > 126) {
        c = ' ';  // Unsupported characters are replaced with a space
    }
    uint8_t index = c - 0;  // Calculate the index in the font array

    // Set the column address
    ssd1306_send_command(0x00 + (col & 0x0F));        // Lower column address
    ssd1306_send_command(0x10 + ((col >> 4) & 0x0F)); // Higher column address

    // Send character to current page (upper 8 bits)
    ssd1306_send_command(0xB0 + row); // Page address
    i2c_start();
    i2c_write_byte(0x3C << 1);  // SSD1306 I2C address
    i2c_write_byte(0x40);       // Control byte for data
    for (int i = 0; i < 8; i++) {
        i2c_write_byte(font8x16[index][i]);
    }
    i2c_stop();

    // Send character to next page (lower 8 bits)
    ssd1306_send_command(0xB0 + row + 1); // Next page address
    ssd1306_send_command(0x00 + (col & 0x0F));        // Lower column address
    ssd1306_send_command(0x10 + ((col >> 4) & 0x0F)); // Higher column address
    i2c_start();
    i2c_write_byte(0x3C << 1);  // SSD1306 I2C address
    i2c_write_byte(0x40);       // Control byte for data
    for (int i = 8; i < 16; i++) {
        i2c_write_byte(font8x16[index][i]);
    }
    i2c_stop();
}

// Write a string using 8x16 font
void ssd1306_write_string_8x16(const char* str, uint8_t row, uint8_t col) {
    while (*str) {
        ssd1306_write_char_8x16(*str, row, col);  // Pass row and col
        col += 8; // Move to the next character position (8 pixels per character)
        if (col > 120) { // If column exceeds display width
            col = 0;     // Reset column
            row += 2;    // Move to the next set of pages (since 8x16 font uses 2 pages)
        }
        if (row > 2) {   // Check if row exceeds the display height for 128x32 display
            break;       // Exit if no more space
        }
        str++;
    }
}

#endif  // GPI2C_H


